## config/west.yml
```yaml
manifest:
  remotes:
    - name: zmkfirmware
      url-base: https://github.com/zmkfirmware
    - name: mentako-ya
      url-base: https://github.com/mentako-ya
    - name: badjeff
      url-base: https://github.com/badjeff
    - name: caksoylar
      url-base: https://github.com/caksoylar
    - name: englmaxi
      url-base: https://github.com/englmaxi

    # ★追加（Raytacドングル用）
    - name: rschenk
      url-base: https://github.com/rschenk

  projects:
    - name: zmk
      remote: zmkfirmware
      revision: main
      import: app/west.yml

    - name: zmk-pmw3610-driver
      remote: badjeff
      revision: main

    - name: zmk-rgbled-widget
      remote: caksoylar
      revision: main

    # ★追加（Raytacドングル用ボード定義など）
    - name: zmk-component-raytac-dongle
      remote: rschenk
      revision: main

  self:
    path: config
```
